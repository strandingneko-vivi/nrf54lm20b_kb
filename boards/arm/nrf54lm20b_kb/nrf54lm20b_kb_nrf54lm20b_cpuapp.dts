/*
 * Copyright (c) 2026 Nordic Semiconductor ASA
 *
 * SPDX-License-Identifier: Apache-2.0
 */

/dts-v1/;

#include <nordic/nrf54lm20b_cpuapp.dtsi>
#include "nrf54lm20b_kb_cpuapp_common.dtsi"

/ {
	compatible = "nordic,nrf54lm20b_kb_nrf54lm20b-cpuapp";
	model = "nRF54LM20B KB Application MCU";

	chosen {
		zephyr,code-partition = &slot0_partition;
		zephyr,sram = &cpuapp_sram;
		zephyr,settings-partition = &storage_partition;
	};
};

/* Include default memory partition configuration file */
#include <vendor/nordic/nrf54lm20b_cpuapp_partition.dtsi>
