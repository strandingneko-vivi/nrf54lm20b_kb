## boards/arm/nrf54lm20b_kb/Kconfig
```kconfig
# Copyright (c) 2026 Nordic Semiconductor ASA
# SPDX-License-Identifier: Apache-2.0

config BOARD_NRF54LM20B_KB
	select SOC_NRF54LM20B_CPUAPP if BOARD_NRF54LM20B_KB_NRF54LM20B_CPUAPP || BOARD_NRF54LM20B_KB_NRF54LM20B_CPUAPP_NS
	select SOC_NRF54LM20B_CPUFLPR if BOARD_NRF54LM20B_KB_NRF54LM20B_CPUFLPR
```

## boards/arm/nrf54lm20b_kb/Kconfig.defconfig
```kconfig
# SPDX-License-Identifier: Apache-2.0

if BOARD_NRF54LM20B_KB_NRF54LM20B_CPUAPP

config HW_STACK_PROTECTION
	default ARCH_HAS_STACK_PROTECTION

endif

if BOARD_NRF54LM20B_KB_NRF54LM20B_CPUAPP_NS

config BUILD_WITH_TFM
	default y

endif
```

## boards/arm/nrf54lm20b_kb/board.yml
```yaml
board:
  name: nrf54lm20b_kb
  full_name: nRF54LM20B KB
  vendor: nordic
  socs:
  - name: nrf54lm20b
    variants:
    - name: ns
      cpucluster: cpuapp
runners:
  run_once:
    '--recover':
    - runners:
      - nrfjprog
      - nrfutil
      run: first
      groups:
      - boards:
        - nrf54lm20b_kb/nrf54lm20b/cpuapp
        - nrf54lm20b_kb/nrf54lm20b/cpuapp/ns
        - nrf54lm20b_kb/nrf54lm20b/cpuflpr
    '--erase':
    - runners:
      - nrfjprog
      - jlink
      - nrfutil
      run: first
      groups:
      - boards:
        - nrf54lm20b_kb/nrf54lm20b/cpuapp
        - nrf54lm20b_kb/nrf54lm20b/cpuapp/ns
        - nrf54lm20b_kb/nrf54lm20b/cpuflpr
    '--reset':
    - runners:
      - nrfjprog
      - jlink
      - nrfutil
      run: last
      groups:
      - boards:
        - nrf54lm20b_kb/nrf54lm20b/cpuapp
        - nrf54lm20b_kb/nrf54lm20b/cpuapp/ns
        - nrf54lm20b_kb/nrf54lm20b/cpuflpr
```
